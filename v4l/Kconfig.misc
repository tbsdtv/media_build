## v4l/Kconfig.misc
```kconfig
#
# Misc strange devices
#
menuconfig MISC_DEVICES
	bool "Misc devices"
	help
	  Say Y here to get to see options for device drivers from various
	  different categories. This option alone does not add any kernel code.

	  If you say N, all options in this submenu will be skipped and disabled.

if MISC_DEVICES

source "../linux/drivers/misc/altera-stapl/Kconfig"

endif # MISC_DEVICES
```

## v4l/Kconfig.sound
```kconfig
menuconfig AUDIO_SUPPORT
bool "Sound card support"
	help
	  Allow to select the Kconfig options found at Kernel's
	  sound/pci/Kconfig file.
	  Currently, only snd-bt87x is available on this backport tree.

if AUDIO_SUPPORT
# This is part of sound/pci/Kconfig
comment "ALSA sound"

config SND_BT87X
	tristate "Bt87x Audio Capture"
	depends on SND && PCI
	select SND_PCM
	help
	  If you want to record audio from TV cards based on
	  Brooktree Bt878/Bt879 chips, say Y here and read
	  <Documentation/sound/alsa/Bt87x.txt>.

	  To compile this driver as a module, choose M here: the module
	  will be called snd-bt87x.

config SND_BT87X_OVERCLOCK
	bool "Bt87x Audio overclocking"
	depends on SND_BT87X
	help
	  Say Y here if 448000 Hz isn't enough for you and you want to
	  record from the analog input with up to 1792000 Hz.

	  Higher sample rates won't hurt your hardware, but audio
	  quality may suffer.
endif
```

## v4l/Kconfig.staging
```kconfig
menuconfig STAGING
	bool "Staging drivers"
	default n
	---help---
	  This option allows you to select a number of drivers that are
	  not of the "normal" Linux kernel quality level.  These drivers
	  are placed here in order to get a wider audience for use of
	  them.  Please note that these drivers are under heavy
	  development, may or may not work, and may contain userspace
	  interfaces that most likely will be changed in the near
	  future.

	  Using any of these drivers will taint your kernel which might
	  affect support options from both the community, and various
	  commercial support orginizations.

	  If you wish to work on these drivers, to help improve them, or
	  to report problems you have with them, please see the
	  driver_name.README file in the drivers/staging/ directory to
	  see what needs to be worked on, and who to contact.

	  If in doubt, say N here.

if STAGING
menu "Media devices in staging"

config STAGING_BROKEN
	bool "Enable drivers that are known to not compile"
	default n
	---help---
	  Say N here, except if you will be fixing the drivers
	  compilation.

source "../linux/drivers/staging/media/Kconfig"
# Currently, there are no broken staging drivers with Kernel 2.6.31
# if STAGING_BROKEN
# endif

endmenu

endif # STAGING
```
